## package/python-regex/Config.in
```kconfig
config BR2_PACKAGE_PYTHON_REGEX
	bool "python-regex"
	help
		Provide python-regex

		https://pypi.python.org/pypi/regex
```

## package/python-rsa/Config.in
```kconfig
	config BR2_PACKAGE_PYTHON_RSA
	bool "python-rsa"
	select BR2_PACKAGE_PYTHON_PYASN1
	help
		Provide python-rsa

		https://pypi.python.org/pypi/rsa
```

## package/python-sarge/Config.in
```kconfig
config BR2_PACKAGE_PYTHON_SARGE
	bool "python-sarge"
	help
	  Provide python-sarge

	  https://pypi.python.org/pypi/sarge
```

## package/python-semantic-version/Config.in
```kconfig
config BR2_PACKAGE_PYTHON_SEMANTIC_VERSION
	bool "python-semantic-version"
	help
		Provide python-semantic-version

		https://github.com/rbarrois/python-semanticversion
```

## package/python-sockjs-tornado/Config.in
```kconfig
config BR2_PACKAGE_PYTHON_SOCKJS_TORNADO
	bool "python-sockjs-tornado"
	select BR2_PACKAGE_PYTHON_TORNADO # runtime
	help
		Provide python-sockjs-tornado

 		https://pypi.python.org/pypi/sockjs-tornado
```

## package/python-speaklater/Config.in
```kconfig
config BR2_PACKAGE_PYTHON_SPEAKLATER
	bool "python-speaklater"
	help
		Provide python-speaklater

		https://pypi.python.org/pypi/speaklater
```

## package/python-sympy/Config.in
```kconfig
config BR2_PACKAGE_PYTHON_SYMPY
	bool "python-sympy"
	select BR2_PACKAGE_PYTHON_MPMATH
	help
	  python-sympy

	  https://pypi.python.org/pypi/sympy
```

## package/python-testfixtures/Config.in
```kconfig
config BR2_PACKAGE_PYTHON_TESTFIXTURES
	bool "python-testfixtures"
	help
	  python-testfixtures
	  
	  https://pypi.python.org/pypi/testfixtures
```

## package/python-unidecode/Config.in
```kconfig
config BR2_PACKAGE_PYTHON_UNIDECODE
	bool "python-unidecode"
	help
		Provide python-unidecode

		https://pypi.python.org/pypi/Unidecode
```

## package/python-webassets/Config.in
```kconfig
config BR2_PACKAGE_PYTHON_WEBASSETS
	bool "python-webassets"
	help
		Provide python-webassets

		https://pypi.python.org/pypi/webassets
```

## package/python-websocket-client/Config.in
```kconfig
config BR2_PACKAGE_PYTHON_WEBSOCKET_CLIENT
	bool "python-websocket-client"
	select BR2_PACKAGE_PYTHON_BACKPORTS_SSL_MATCH_HOSTNAME
	help
		Provide python-websocket-client

		https://github.com/websocket-client/websocket-client
```

## package/python-wrapt/Config.in
```kconfig
config BR2_PACKAGE_PYTHON_WRAPT
	bool "python-wrapt"
	help
		Provide python-wrapt

		https://github.com/GrahamDumpleton/wrapt
```

## package/redeem/Config.in
```kconfig
config BR2_PACKAGE_REDEEM
	bool "redeem"
	select BR2_PACKAGE_PYTHON
	select BR2_PACKAGE_PYTHON_NUMPY # setup.py + runtime
	select BR2_PACKAGE_PYTHON_CONFIGOBJ # runtime
	select BR2_PACKAGE_PYTHON_TESTFIXTURES # runtime
	select BR2_PACKAGE_PYTHON_SYMPY # runtime
	select BR2_PACKAGE_PYTHON_SH # runtime
	select BR2_PACKAGE_PYTHON_SIX # runtime
	select BR2_PACKAGE_PYTHON_PYUSB # runtime
	select BR2_PACKAGE_PYTHON_PY # runtime
	select BR2_PACKAGE_PYTHON_MOCK # runtime
	select BR2_PACKAGE_PYTHON_FUNCSIGS # runtime
	select BR2_PACKAGE_PYTHON_DOCUTILS # runtime
	select BR2_PACKAGE_PYTHON_ADAFRUIT_GPIO # runtime
	select BR2_PACKAGE_PYTHON_EVDEV # runtime
	help
		Provide Redeem

		https://github.com/intelligent-agent/redeem
```
