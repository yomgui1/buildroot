## configs/bbb_buildroot_defconfig
```kconfig
BR2_arm=y
BR2_cortex_a8=y
BR2_DL_DIR="$(TOPDIR)/../buildroot-dl"
BR2_CCACHE=y
BR2_GLOBAL_PATCH_DIR="board/beaglebone/patches"
BR2_TOOLCHAIN_EXTERNAL=y
BR2_ROOTFS_MERGED_USR=y
BR2_TARGET_GENERIC_GETTY_PORT="ttyS0"
BR2_ROOTFS_USERS_TABLES="$(TOPDIR)/board/beaglebone/users"
BR2_ROOTFS_OVERLAY="$(TOPDIR)/board/beaglebone/rootfs"
BR2_ROOTFS_POST_IMAGE_SCRIPT="board/beaglebone/post-image.sh"
BR2_LINUX_KERNEL=y
BR2_LINUX_KERNEL_CUSTOM_GIT=y
BR2_LINUX_KERNEL_CUSTOM_REPO_URL="https://github.com/beagleboard/linux.git"
BR2_LINUX_KERNEL_CUSTOM_REPO_VERSION="4.14"
BR2_LINUX_KERNEL_USE_CUSTOM_CONFIG=y
BR2_LINUX_KERNEL_CUSTOM_CONFIG_FILE="$(TOPDIR)/board/beaglebone/linux.defconfig"
BR2_LINUX_KERNEL_DTS_SUPPORT=y
BR2_LINUX_KERNEL_INTREE_DTS_NAME="am335x-boneblack-uboot"
BR2_PACKAGE_LINUX_TOOLS_CPUPOWER=y
BR2_PACKAGE_LINUX_TOOLS_GPIO=y
BR2_PACKAGE_LINUX_TOOLS_IIO=y
BR2_PACKAGE_LINUX_TOOLS_TMON=y
BR2_PACKAGE_BUSYBOX_SHOW_OTHERS=y
BR2_PACKAGE_BINUTILS=y
BR2_PACKAGE_BINUTILS_TARGET=y
BR2_PACKAGE_GIT=y
BR2_PACKAGE_AM335X_PRU_PACKAGE=y
BR2_PACKAGE_PYTHON_PY_PYC=y
BR2_PACKAGE_PYTHON_BZIP2=y
BR2_PACKAGE_PYTHON_READLINE=y
BR2_PACKAGE_PYTHON_SQLITE=y
BR2_PACKAGE_PYTHON_HASHLIB=y
BR2_PACKAGE_PYTHON_SCANDIR=y
BR2_PACKAGE_PYTHON_SIMPLEJSON=y
BR2_PACKAGE_LIBGPIOD=y
BR2_PACKAGE_LIBGPIOD_TOOLS=y
BR2_PACKAGE_OCTOPRINT=y
BR2_PACKAGE_REDEEM=y
BR2_PACKAGE_DHCPCD=y
BR2_PACKAGE_DNSMASQ=y
# BR2_PACKAGE_DNSMASQ_TFTP is not set
BR2_PACKAGE_DROPBEAR=y
BR2_PACKAGE_MJPG_STREAMER=y
BR2_PACKAGE_SOCAT=y
BR2_PACKAGE_BASH=y
BR2_PACKAGE_SUDO=y
BR2_PACKAGE_START_STOP_DAEMON=y
BR2_PACKAGE_UEMACS=y
BR2_TARGET_ROOTFS_EXT2=y
BR2_TARGET_ROOTFS_EXT2_4=y
BR2_TARGET_ROOTFS_EXT2_LABEL="rootfs"
BR2_TARGET_ROOTFS_EXT2_SIZE="300M"
BR2_TARGET_UBOOT=y
BR2_TARGET_UBOOT_BUILD_SYSTEM_KCONFIG=y
BR2_TARGET_UBOOT_BOARD_DEFCONFIG="am335x_boneblack"
BR2_TARGET_UBOOT_NEEDS_DTC=y
# BR2_TARGET_UBOOT_FORMAT_BIN is not set
BR2_TARGET_UBOOT_FORMAT_IMG=y
BR2_TARGET_UBOOT_FORMAT_CUSTOM=y
BR2_TARGET_UBOOT_FORMAT_CUSTOM_NAME="spl/u-boot-spl.bin"
BR2_TARGET_UBOOT_SPL=y
BR2_TARGET_UBOOT_SPL_NAME="MLO"
BR2_PACKAGE_HOST_DOSFSTOOLS=y
BR2_PACKAGE_HOST_GENIMAGE=y
BR2_PACKAGE_HOST_MTOOLS=y
```

## package/octoprint/Config.in
```kconfig
config BR2_PACKAGE_OCTOPRINT
	bool "octoprint"
	select BR2_PACKAGE_PYTHON_MONOTONIC # runtime
	select BR2_PACKAGE_PYTHON_EMOJI # runtime
	select BR2_PACKAGE_PYTHON_FUTURES # runtime
	select BR2_PACKAGE_PYTHON_WRAPT # runtime
	select BR2_PACKAGE_PYTHON_DATEUTIL # runtime
	select BR2_PACKAGE_PYTHON_WEBSOCKET_CLIENT # runtime
	select BR2_PACKAGE_PYTHON_FUTURE # runtime
	select BR2_PACKAGE_PYTHON_CHAINMAP # runtime
	select BR2_PACKAGE_PYTHON_FEEDPARSER # runtime
	select BR2_PACKAGE_PYTHON_AWESOME_SLUGIFY # runtime
	select BR2_PACKAGE_PYTHON_CLICK # runtime
	select BR2_PACKAGE_PYTHON_PSUTIL # runtime
	select BR2_PACKAGE_PYTHON_SEMANTIC_VERSION # runtime
	select BR2_PACKAGE_PYTHON_REQUESTS # runtime
	select BR2_PACKAGE_PYTHON_PKGINFO # runtime
	select BR2_PACKAGE_PYTHON_RSA # runtime
	select BR2_PACKAGE_PYTHON_PYLRU # runtime
	select BR2_PACKAGE_PYTHON_NETIFACES # runtime
	select BR2_PACKAGE_PYTHON_SARGE # runtime
	select BR2_PACKAGE_PYTHON_WATCHDOG # runtime
	select BR2_PACKAGE_PYTHON_NETADDR # runtime
	select BR2_PACKAGE_PYTHON_SERIAL # runtime
	select BR2_PACKAGE_PYTHON_MARKDOWN # runtime
	select BR2_PACKAGE_PYTHON_FLASK_ASSETS # runtime
	select BR2_PACKAGE_PYTHON_FLASK_BABEL # runtime
	select BR2_PACKAGE_PYTHON_FLASK_PRINCIPAL # runtime
	select BR2_PACKAGE_PYTHON_FLASK_LOGIN # runtime
	select BR2_PACKAGE_PYTHON_PYYAML # runtime
	select BR2_PACKAGE_PYTHON_SOCKJS_TORNADO # runtime
	select BR2_PACKAGE_PYTHON_TORNADO # runtime
	select BR2_PACKAGE_PYTHON_WERKZEUG # runtime
	select BR2_PACKAGE_PYTHON_JINJA2 # runtime
	help
		Provide OctoPrint

		https://octoprint.org/
```

## package/python-adafruit-bbio/Config.in
```kconfig
config BR2_PACKAGE_PYTHON_ADAFRUIT_BBIO
	bool "python-adafruit-bbio"
	help
	  python-adafruit-bbio

	  https://pypi.python.org/pypi/Adafruit_BBIO
```

## package/python-adafruit-gpio/Config.in
```kconfig
config BR2_PACKAGE_PYTHON_ADAFRUIT_GPIO
	bool "python-adafruit-gpio"
	select BR2_PACKAGE_PYTHON_ADAFRUIT_BBIO # runtime
	select BR2_PACKAGE_PYTHON_ADAFRUIT_PUREIO # runtime
	help
	  python-adafruit-gpio

	  https://pypi.python.org/pypi/Adafruit_GPIO
```

## package/python-adafruit-pureio/Config.in
```kconfig
config BR2_PACKAGE_PYTHON_ADAFRUIT_PUREIO
	bool "python-adafruit-pureio"
	help
	  python-adafruit-pureio

	  https://pypi.python.org/pypi/Adafruit_PureIO/
```

## package/python-awesome-slugify/Config.in
```kconfig
config BR2_PACKAGE_PYTHON_AWESOME_SLUGIFY
	bool "python-awesome-slugify"
	select BR2_PACKAGE_PYTHON_REGEX
	select BR2_PACKAGE_PYTHON_UNIDECODE
	help
		Provide python-awesome-slugify

		https://github.com/dimka665/awesome-slugify
```

## package/python-backports-ssl-match-hostname/Config.in
```kconfig
config BR2_PACKAGE_PYTHON_BACKPORTS_SSL_MATCH_HOSTNAME
	bool "python-backports-ssl-match-hostname"
	help
		Provide python-backports-ssl-match-hostname
		
		https://pypi.python.org/pypi/backports.ssl_match_hostname
```

## package/python-blinker/Config.in
```kconfig
config BR2_PACKAGE_PYTHON_BLINKER
	bool "python-blinker"
	help
		Provide python-blinker
		
		https://pypi.python.org/pypi/blinker
```

## package/python-chainmap/Config.in
```kconfig
config BR2_PACKAGE_PYTHON_CHAINMAP
	bool "python-chainmap"
	help
		Provide python-chainmap

		https://bitbucket.org/jeunice/chainmap
```

## package/python-emoji/Config.in
```kconfig
config BR2_PACKAGE_PYTHON_EMOJI
	bool "python-emoji"
	help
		Provide python-emoji

		https://github.com/carpedm20/emoji
```

## package/python-evdev/Config.in
```kconfig
	config BR2_PACKAGE_PYTHON_EVDEV
	bool "python-evdev"
	help
	  python-evdev

	  https://pypi.python.org/pypi/evdev
```

## package/python-feedparser/Config.in
```kconfig
config BR2_PACKAGE_PYTHON_FEEDPARSER
	bool "python-feedparser"
	help
		Provide python-feedparser

		https://github.com/kurtmckee/feedparser
```

## package/python-flask-assets/Config.in
```kconfig
config BR2_PACKAGE_PYTHON_FLASK_ASSETS
	bool "python-flask-assets"
	select BR2_PACKAGE_PYTHON_FLASK # runtime
	select BR2_PACKAGE_PYTHON_WEBASSETS # runtime
	help
		Provide Flask-Assets
		
		https://pypi.python.org/pypi/Flask-Assets
```

## package/python-flask-principal/Config.in
```kconfig
config BR2_PACKAGE_PYTHON_FLASK_PRINCIPAL
	bool "python-flask-principal"
	select BR2_PACKAGE_PYTHON_FLASK # runtime
	select BR2_PACKAGE_PYTHON_BLINKER # runtime
	help
		Provide Flask-Principal
		
		https://pypi.python.org/pypi/Flask-Principal
```

## package/python-funcsigs/Config.in
```kconfig
config BR2_PACKAGE_PYTHON_FUNCSIGS
	bool "python-funcsigs"
	help
	  python-funcsigs

	  https://pypi.python.org/pypi/funcsigs
```

## package/python-future/Config.in
```kconfig
config BR2_PACKAGE_PYTHON_FUTURE
	bool "python-future"
	help
		Provide python-future

		https://github.com/PythonCharmers/python-future
```

## package/python-mock/Config.in
```kconfig
config BR2_PACKAGE_PYTHON_MOCK
	bool "python-mock"
	select BR2_PACKAGE_PYTHON_PBR # host
	help
	  python-mock

	  https://pypi.python.org/pypi/mock
```

## package/python-monotonic/Config.in
```kconfig
config BR2_PACKAGE_PYTHON_MONOTONIC
	bool "python-monotonic"
	help
		Provide python-monotonic

		https://github.com/atdt/monotonic/
```

## package/python-mpmath/Config.in
```kconfig
config BR2_PACKAGE_PYTHON_MPMATH
	bool "python-mpmath"
	help
		python-mpmath

		https://pypi.python.org/pypi/mpmath
```

## package/python-pbr/Config.in
```kconfig
config BR2_PACKAGE_PYTHON_PBR
	bool "python-pbr"
	help
	  python-pbr

	  https://pypi.python.org/pypi/pbr
```

## package/python-pip/Config.in
```kconfig
config BR2_PACKAGE_PYTHON_PIP
	bool "python-pip"
	help
	  python-pip

	  https://pypi.python.org/pypi/pip/
```

## package/python-pkginfo/Config.in
```kconfig
config BR2_PACKAGE_PYTHON_PKGINFO
	bool "python-pkginfo"
	help
		Provide python-pkginfo

		https://pypi.python.org/pypi/pkginfo/
```

## package/python-py/Config.in
```kconfig
config BR2_PACKAGE_PYTHON_PY
	bool "python-py"
	help
	  python-py

	  https://pypi.python.org/pypi/py
```

## package/python-pyasn1/Config.in
```kconfig
config BR2_PACKAGE_PYTHON_PYASN1
	bool "python-pyasn1"
	help
		Provide python-pyasn1

		https://pypi.python.org/pypi/pyasn1
```
